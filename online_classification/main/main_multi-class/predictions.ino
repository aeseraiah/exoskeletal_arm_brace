// This file covers the prediction of movement

float model_predictions(double bicep_rms, double tricep_rms) {
  const int number_data_points = 1; // single pair of RMS values
  const int num_classes = 3;

  //AIfES requires random weights for training
  //Here the random seed is generated by the noise of an analog pin
  srand(analogRead(A5));
  float input_data[number_data_points*2];
  input_data[0] = bicep_rms;
  input_data[1] = tricep_rms;

  uint16_t input_shape[] = {1, 2}; // single RMS data point (bi, tri) --> single row, two columns                                 
  aitensor_t input_tensor = AITENSOR_2D_F32(input_shape, input_data);   // Creation of the input AIfES tensor

  // Tensor for the output with 3 classes
  // Output values of the ANN are saved here
  uint16_t output_shape[] = {number_data_points, num_classes};
  float output_data[number_data_points*num_classes];                                                  
  aitensor_t output_tensor = AITENSOR_2D_F32(output_shape, output_data);  // Creation of the output AIfES tensor


  aialgo_inference_model(&model, &input_tensor, &output_tensor);

  float max_prob;
  String predicted_label;
  max_prob = output_data[0];
  for (int i = 0; i < num_classes; i++) {
      // order of probabilities follows order of labeling --> flexion, extension, rest
      // if current probability is greater than first probability (flexion), than reassign max_prob
      if (output_data[i] >= max_prob) {
        max_prob = output_data[i];
        if (i == 0) { // if num_class index is 0
          predicted_label = "flexion";
          // ACTUATE SERVO:
          // String movement = flexion;
          // actuateServo(movement)
          // myservo.write(130);
          // delay(500);
        }
        else if (i == 1) {
          predicted_label = "extension";
          // ACTUATE SERVO:
          // String movement = flexion;
            // actuateServo(movement)
            // myservo.write(5);
          // delay(500);
        }
        else {
          // do not move servo 
          predicted_label = "rest";
        }
      } 
  }

  Serial.println(F(""));
  Serial.println(F("PREDICTIONS:"));
  Serial.println(F("Bicep RMS:\tTricep RMS 2:\tcalculated output:\tpredicted label:"));

  // ----------------------------------------- Output of results --------------------------
  
  Serial.print(input_data[0]);
  Serial.print(F("\t\t"));
  Serial.print(input_data[1]);
  Serial.print(F("\t\t"));

  for (int i = 0; i < num_classes; i++) {
    Serial.print(output_data[i]);
    Serial.print(F(" "));
  }

  Serial.print(F("\t\t"));
  Serial.println(predicted_label);

  if (predicted_label == "flexion") {
    Serial.println("Writing 130");
    // myservo.write(130);
    // delay(500);

  }
  else if (predicted_label == "extension") {
    if (bicep_rms && tricep_rms > 10) {
      Serial.println("Writing 5");
      // myservo.write(5);
      // delay(500);    
    }
  }

  return;

}